## app/dts/bindings/behaviors/zmk,behavior-layer-switched-key-repeat.yaml
```yaml
description: Repeat key position in a new layer behavior

compatible: "zmk,behavior-layer-switched-key-repeat"

include: one_param.yaml
```

## app/dts/bindings/behaviors/zmk,behavior-mouse-decrease-sensitivity.yaml
```yaml
description: Mouse decrease sensitivity behavior

compatible: "zmk,behavior-mouse-decrease-sensitivity"

include: zero_param.yaml
```

## app/dts/bindings/behaviors/zmk,behavior-mouse-increase-sensitivity.yaml
```yaml
description: Mouse increase sensitivity behavior

compatible: "zmk,behavior-mouse-increase-sensitivity"

include: zero_param.yaml
```
